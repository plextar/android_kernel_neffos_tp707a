/ {
	rsee {
		compatible = "rongcard,rsee-tz";
		method = "smc";
	};
	spi0-clk {
		compatible = "rsee,peri-clk";
		mediatek,pad-select = <0>;
		reg = <0 0x1100a000 0 0x1000>;
		interrupts = <GIC_SPI 118 IRQ_TYPE_LEVEL_LOW>;
		clkname = "parent-clk", "sel-clk", "spi-clk";
		clocks = <&topckgen CLK_TOP_SYSPLL3_D2>,
				<&topckgen CLK_TOP_SPI_SEL>,
				<&infracfg_ao CLK_INFRA_SPI0>;
		clock-names = "parent-clk", "sel-clk", "spi-clk";
	
	/*
	    clkname = "spi-main"; 
		clocks = <&infracfg_ao CLK_INFRA_SPI0>;
		clock-names = "spi-main";
	*/	
		clock-frequency = <109000000>;
		clock-div = <1>;
	};
};

