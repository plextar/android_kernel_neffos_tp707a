## drivers/input/fingerprint/fpsensor/Kconfig
```kconfig
config ICNT_FPSENSOR
	tristate "ICNT7332 fingerprint driver"
	depends on SPI
	default y
	---help---
	  fpsensor ICNT7332 fingureprint driver.
	  This is a driver based on the SPI kernel layers.

	  To compile this driver as a module, choose m here. The module will
	  be called fpsensor.
	  Say N if unsure.
```

## drivers/misc/mediatek/sensors-1.0/alsps/stk3x1x/Kconfig
```kconfig
config MTK_STK3X1XM
        bool "stk3x1x_ontim for MediaTek package"
        default n
```
